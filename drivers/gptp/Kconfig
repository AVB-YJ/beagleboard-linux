## drivers/gptp/Kconfig
```kconfig
#
# IEEE 802.1AS gPTP Configuration
#             

config NET_G_PTP
	tristate "gPTP"
	default m
	---help---
	  If you have a network (Ethernet) card belonging to this class, say Y.

	  Note that the answer to this question doesn't directly affect the
	  kernel: saying N will just cause the configurator to skip all
	  the questions about Microchip cards. If you say Y, you will be asked
	  for your specific card in the following questions.
```
